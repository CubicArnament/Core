/* linker.ld - Скрипт компоновщика для нашего ядра (без изменений) */
ENTRY(_start) /* Точка входа, определенная в boot.s */

SECTIONS
{
    /* Ядро будет загружено по адресу 1MB (0x100000) */
    . = 0x100000;

    .text : ALIGN(4K)
    {
        *(.multiboot_header) /* Сначала заголовок Multiboot */
        *(.text)             /* Затем весь остальной код */
    }

    .rodata : ALIGN(4K)
    {
        *(.rodata)           /* Данные только для чтения */
    }

    .data : ALIGN(4K)
    {
        *(.data)             /* Инициализированные данные */
    }

    .bss : ALIGN(4K)
    {
        *(.bss)              /* Неинициализированные данные */
    }

    /DISCARD/ :
    {
        *(.comment)
        *(.eh_frame)
    }
}